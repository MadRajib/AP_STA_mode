## src/Kconfig.projbuild
```kconfig
menu "Example Configuration"

    config AP_SSID
        string "AP SSID"
        default "MADRAJIBLAB"
        help
            SSID (network name) for the example to connect to.

    config AP_PASSWORD
        string "AP Password"
        default "HELLOWORLD"
        help
            WiFi password (WPA or WPA2) for the example to use.

    config AP_CHANNEL
        int "AP Channel"
        range 1 13
        default 1
        help
            WiFi channel (network channel) for the example to use.

    config AP_MAX_STA_CONN
        int "Maximal STA connections"
        default 4
        help
            Max number of the STA connects to AP.
    
    config STA_MAXIMUM_RETRY
        int "Maximum retry"
        default 10
        help
            Set the Maximum retry to avoid station reconnecting to the AP unlimited when the AP is really inexistent.
    
    config EXAMPLE_RMT_TX_GPIO
        int "RMT TX GPIO"
        default 2
        help
            Set the GPIO number used for transmitting the RMT signal.
        
    config EXAMPLE_STRIP_LED_NUMBER
        int "Number of LEDS in a strip"
        default 64
        help
            A single RGB strip contains several LEDs.
endmenu
```
